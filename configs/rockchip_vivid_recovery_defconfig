## configs/rockchip_vivid_recovery_defconfig
```kconfig
#include "base/base.config"
#include "base/recovery.config"
#include "chips/rk3399_aarch64.config"
BR2_PACKAGE_RECOVERY_USE_ROTATION_RIGHT=y
```
